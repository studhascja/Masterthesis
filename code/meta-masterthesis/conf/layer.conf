## code/meta-masterthesis/conf/layer.conf
```bitbake
BBPATH .= ":${LAYERDIR}"
BBFILES += "${LAYERDIR}/recipes-*/*/*.bb \ 
	    ${LAYERDIR}/recipes-*/*/*.bbappend \ 
           "

BBFILE_COLLECTIONS += "masterthesis"
BBFILE_PATTERN_masterthesis := "^${LAYERDIR}/"
BBFILE_PRIORITY_masterthesis = "6"

LAYERSERIES_COMPAT_masterthesis = "walnascar"
```
